/ {
    chosen {
        zmk,kscan = &kscan_mock;
    };
    kscan_mock: kscan_mock {
        compatible = "zmk,kscan-mock";
        columns = <0>;
        rows = <0>;
        events = <0>;
    };
};
